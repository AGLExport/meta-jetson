## conf/layer.conf
```bitbake
# We have a conf and classes directory, add to BBPATH
BBPATH .= ":${LAYERDIR}"

# We have a recipes-* directories, add to BBFILES
BBFILES += " \
	${LAYERDIR}/recipes-*/*/*.bb \
	${LAYERDIR}/recipes-*/*/*.bbappend \
"

BBFILE_COLLECTIONS += "jetson"
BBFILE_PATTERN_jetson = "^${LAYERDIR}/"
BBFILE_PRIORITY_jetson = "20"
```

## conf/machine/jetson-tk1-upstream.conf
```bitbake
#@TYPE: Machine
#@NAME: NVidia Jetson TK1
#@DESCRIPTION: NVidia Jetson TK1 board

require conf/machine/include/tune-cortexa15.inc

DEFAULTTUNE = "cortexa15hf-neon"

PREFERRED_PROVIDER_virtual/xserver ?= "xserver-xorg"
PREFERRED_PROVIDER_virtual/kernel ?= "linux-upstream"
PREFERRED_PROVIDER_virtual/mesa ?= "mesa"
PREFERRED_PROVIDER_virtual/libgl ?= "mesa"

SERIAL_CONSOLE = "115200 ttyS0"

KERNEL_IMAGETYPE = "zImage"

MACHINE_ESSENTIAL_EXTRA_RRECOMMENDS += " \
            bootconfig \
            gpuconf \
            kernel-image \
            kernel-devicetree \
            linux-firmware-nvidia \
            linux-firmware-rtl8168g \
            kernel-modules \
            libdrm-tegra \
            libdrm-kms \
            mesa-megadriver \
            "

IMAGE_FSTYPES = "tar.bz2"
```

## conf/machine/jetson-tx1-upstream.conf
```bitbake
#@TYPE: Machine
#@NAME: NVidia Jetson TX1
#@DESCRIPTION: NVidia Jetson TX1 board

require conf/machine/include/tune-cortexa57.inc

PREFERRED_PROVIDER_virtual/xserver ?= "xserver-xorg"
PREFERRED_PROVIDER_virtual/kernel ?= "linux-upstream"
PREFERRED_PROVIDER_virtual/mesa ?= "mesa"
PREFERRED_PROVIDER_virtual/libgl ?= "mesa"

SERIAL_CONSOLE = "115200 ttyS0"

KERNEL_IMAGETYPE = "Image"

MACHINE_ESSENTIAL_EXTRA_RRECOMMENDS += " \
            bootconfig \
            gpuconf \
            kernel-image \
            kernel-devicetree \
            linux-firmware-nvidia \
            linux-firmware-bcm4354 \
            kernel-modules \
            libdrm-tegra \
            libdrm-kms \
            mesa-megadriver \
            "

IMAGE_FSTYPES = "tar.bz2"
```

## meta-agl-support/conf/layer.conf
```bitbake
# We have a conf and classes directory, add to BBPATH
BBPATH =. "${LAYERDIR}:"

# We have recipes-* directories, add to BBFILES
BBFILES += "${LAYERDIR}/recipes-*/*/*.bb \
            ${LAYERDIR}/recipes-*/*/*.bbappend"

BBFILE_COLLECTIONS += "agl-support"
BBFILE_PATTERN_agl-support = "^${LAYERDIR}/"
BBFILE_PRIORITY_agl-support = "25"
```
